# file: LCDTest.ioc
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ADC1.Channel-0\#ChannelRegularConversion=ADC_CHANNEL_1
ADC1.NbrOfConversionFlag=1
ADC1.OffsetNumber-0\#ChannelRegularConversion=ADC_OFFSET_NONE
ADC1.Rank-0\#ChannelRegularConversion=1
ADC1.SamplingTime-0\#ChannelRegularConversion=ADC_SAMPLETIME_1CYCLE_5
ADC1.SingleDiff-0\#ChannelRegularConversion=ADC_DIFFERENTIAL_ENDED
ADC1.master=1
ETH.MediaInterface=HAL_ETH_RMII_MODE
I2C1.Timing=0x10909CEC
LTDC.Green_L0=255
LTDC.Layers=0
LTDC.Red_L1=122
LTDC.WindowX1_L0=640
LTDC.WindowX1_L1=640
LTDC.WindowY1_L0=480
LTDC.WindowY1_L1=480
Mcu.Family=STM32H7
Mcu.Name=STM32H753XIHx
Mcu.Package=TFBGA240
NVIC.PriorityGroup=NVIC_PRIORITYGROUP_4
PA0_C.GPIO_Label=Potentiometer
PA0_C.Signal=ADCx_INN1
PA1.GPIO_Label=RMII_REF_CLK [LAN8742A_REFCLK0]
PA1.Mode=RMII
PA1.Signal=ETH_REF_CLK
PA10.GPIO_Label=USB_FS1_ID
PA10.Signal=USB_OTG_FS_ID
PA11.GPIO_Label=USB_FS1_DM
PA11.Mode=Device_Only
PA11.Signal=USB_OTG_FS_DM
PA12.GPIO_Label=USB_FS1_DP
PA12.Mode=Device_Only
PA12.Signal=USB_OTG_FS_DP
PA1_C.Signal=ADCx_INP1
PA2.GPIO_Label=ETH_MDIO [LAN8742A_MDIO]
PA2.Mode=RMII
PA2.Signal=ETH_MDIO
PA3.GPIO_Label=ULPI_D0 [USB3320C_D0]
PA3.Mode=Device_HS
PA3.Signal=USB_OTG_HS_ULPI_D0
PA4.GPIO_Label=LED3_RGB [LD3_Red]
PA4.Signal=GPIO_Output
PA5.GPIO_Label=ULPI_CK  [USB3320C_CLKOUT]
PA5.Mode=Device_HS
PA5.Signal=USB_OTG_HS_ULPI_CK
PA6.GPIO_Label=LCD_BL_CTRL
PA6.Signal=GPIO_Output
PA7.GPIO_Label=RMII_CRS_DV [LAN8742A_CRS_DV]
PA7.Mode=RMII
PA7.Signal=ETH_CRS_DV
PA8.GPIO_Label=MCO
PA8.Mode=Clock-out-1
PA8.Signal=RCC_MCO_1
PA9.GPIO_Label=VBUS_FS1
PA9.Signal=USB_OTG_FS_VBUS
PB0.GPIO_Label=ULPI_D1 [USB3320C_D1]
PB0.Mode=Device_HS
PB0.Signal=USB_OTG_HS_ULPI_D1
PB1.GPIO_Label=ULPI_D2 [USB3320C_D2]
PB1.Mode=Device_HS
PB1.Signal=USB_OTG_HS_ULPI_D2
PB10.GPIO_Label=ULPI_D3 [USB3320C_D3]
PB10.Mode=Device_HS
PB10.Signal=USB_OTG_HS_ULPI_D3
PB11.GPIO_Label=ULPI_D4 [USB3320C_D4]
PB11.Mode=Device_HS
PB11.Signal=USB_OTG_HS_ULPI_D4
PB12.GPIO_Label=ULPI_D5 [USB3320C_D5]
PB12.Mode=Device_HS
PB12.Signal=USB_OTG_HS_ULPI_D5
PB13.GPIO_Label=ULPI_D6 [USB3320C_D6]
PB13.Mode=Device_HS
PB13.Signal=USB_OTG_HS_ULPI_D6
PB14.GPIO_Label=RS232_TX [ST3241EBPR_T2IN]
PB14.Mode=Asynchronous
PB14.Signal=USART1_TX
PB15.GPIO_Label=RS_232RX [ST3241EBPR_R3OUT]
PB15.Mode=Asynchronous
PB15.Signal=USART1_RX
PB2.GPIO_Label=QSPI_CLK [MT25TL01GHBA8ESF_CLK_1]
PB2.Mode=Dual_Bank
PB2.Signal=QUADSPI_CLK
PB5.GPIO_Label=ULPI_D7 [USB3320C_D7]
PB5.Mode=Device_HS
PB5.Signal=USB_OTG_HS_ULPI_D7
PB6.GPIO_Label=I2C1_SCL [STM32L152CCT6_I2C_SCL]
PB6.Mode=I2C
PB6.Signal=I2C1_SCL
PB7.GPIO_Label=I2C1_SDA [STM32L152CCT6_I2C_SDA]
PB7.Mode=I2C
PB7.Signal=I2C1_SDA
PB8.GPIO_Label=SDIO1_CKIN
PB8.Mode=SD_4_bits_Wide_bus_dir_voltage_converter
PB8.Signal=SDMMC1_CKIN
PB9.GPIO_Label=SDIO1_CDIR
PB9.Mode=SD_4_bits_Wide_bus_dir_voltage_converter
PB9.Signal=SDMMC1_CDIR
PC0.GPIO_Label=ULPI_STP [USB3320C_STP]
PC0.Mode=Device_HS
PC0.Signal=USB_OTG_HS_ULPI_STP
PC1.GPIO_Label=RMII_MDC [LAN8742A_MDC]
PC1.Mode=RMII
PC1.Signal=ETH_MDC
PC10.GPIO_Label=SDIO1_D2
PC10.Mode=SD_4_bits_Wide_bus_dir_voltage_converter
PC10.Signal=SDMMC1_D2
PC11.GPIO_Label=SDIO1_D3
PC11.Mode=SD_4_bits_Wide_bus_dir_voltage_converter
PC11.Signal=SDMMC1_D3
PC12.GPIO_Label=SDIO1_CLK
PC12.Mode=SD_4_bits_Wide_bus_dir_voltage_converter
PC12.Signal=SDMMC1_CK
PC13.GPIO_Label=TAMPER_KEY [B1]
PC13.Signal=RTC_TAMP1
PC14-OSC32_IN\ (OSC32_IN).Mode=LSE-External-Oscillator
PC14-OSC32_IN\ (OSC32_IN).Signal=RCC_OSC32_IN
PC15-OSC32_OUT\ (OSC32_OUT).Mode=LSE-External-Oscillator
PC15-OSC32_OUT\ (OSC32_OUT).Signal=RCC_OSC32_OUT
PC2.GPIO_Label=DFSDM_CLK
PC2.Signal=S_CKOUTDFSDM1
PC3.GPIO_Label=DFSM_DAT1
PC3.Signal=S_DATAIN1DFSDM1
PC4.GPIO_Label=RMII_RXD0 [LAN8742A_RXD0]
PC4.Mode=RMII
PC4.Signal=ETH_RXD0
PC5.GPIO_Label=RMII_RXD1 [LAN8742A_RXD1]
PC5.Mode=RMII
PC5.Signal=ETH_RXD1
PC6.GPIO_Label=SDIO1_D0DIR
PC6.Mode=SD_4_bits_Wide_bus_dir_voltage_converter
PC6.Signal=SDMMC1_D0DIR
PC7.GPIO_Label=SDIO1_D123DIR
PC7.Mode=SD_4_bits_Wide_bus_dir_voltage_converter
PC7.Signal=SDMMC1_D123DIR
PC8.GPIO_Label=SDIO1_D0
PC8.Mode=SD_4_bits_Wide_bus_dir_voltage_converter
PC8.Signal=SDMMC1_D0
PC9.GPIO_Label=SDIO1_D1
PC9.Mode=SD_4_bits_Wide_bus_dir_voltage_converter
PC9.Signal=SDMMC1_D1
PD0.GPIO_Label=D2 [IS42S32800G_DQ2]
PD0.Signal=FMC_D2_DA2
PD1.GPIO_Label=D3 [IS42S32800G_DQ3]
PD1.Signal=FMC_D3_DA3
PD10.GPIO_Label=D15 [IS42S32800G_DQ15]
PD10.Signal=FMC_D15_DA15
PD11.GPIO_Label=A16 [PC28F128M29EWLA_A16]
PD11.Signal=FMC_A16_CLE
PD12.GPIO_Label=A17 [PC28F128M29EWLA_A17]
PD12.Signal=FMC_A17_ALE
PD13.GPIO_Label=A18 [PC28F128M29EWLA_A18]
PD13.Signal=FMC_A18
PD14.GPIO_Label=D0 [IS42S32800G_DQ0]
PD14.Signal=FMC_D0_DA0
PD15.GPIO_Label=D1 [IS42S32800G_DQ1]
PD15.Signal=FMC_D1_DA1
PD2.GPIO_Label=SDIO1_CMD
PD2.Mode=SD_4_bits_Wide_bus_dir_voltage_converter
PD2.Signal=SDMMC1_CMD
PD3.GPIO_Label=FDCAN1_STBY [MCP2562FD_STBY]
PD3.Signal=GPIO_Output
PD4.GPIO_Label=FMC_NOE [IS61WV102416BLL_OE]
PD4.Signal=FMC_NOE
PD5.GPIO_Label=FMC_NWE [IS61WV102416BLL_WE]
PD5.Signal=FMC_NWE
PD6.GPIO_Label=FMC_NWAIT [PC28F128M29EWLA_RB]
PD6.Signal=FMC_NWAIT
PD7.GPIO_Label=FMC_NE1 [PC28F128M29EWLA_E]
PD7.Mode=NorPsramChipSelect1_1
PD7.Signal=FMC_NE1
PD8.GPIO_Label=D13 [IS42S32800G_DQ13]
PD8.Signal=FMC_D13_DA13
PD9.GPIO_Label=D14 [IS42S32800G_DQ14]
PD9.Signal=FMC_D14_DA14
PE0.GPIO_Label=FMC_NBL0 [IS42S32800G_DQM0]
PE0.Signal=FMC_NBL0
PE1.GPIO_Label=FMC_NBL1 [IS42S32800G_DQM1]
PE1.Signal=FMC_NBL1
PE10.GPIO_Label=D7 [IS42S32800G_DQ7]
PE10.Signal=FMC_D7_DA7
PE11.GPIO_Label=D8 [IS42S32800G_DQ8]
PE11.Signal=FMC_D8_DA8
PE12.GPIO_Label=D9 [IS42S32800G_DQ9]
PE12.Signal=FMC_D9_DA9
PE13.GPIO_Label=D10 [IS42S32800G_DQ10]
PE13.Signal=FMC_D10_DA10
PE14.GPIO_Label=D11 [IS42S32800G_DQ11]
PE14.Signal=FMC_D11_DA11
PE15.GPIO_Label=D12 [IS42S32800G_DQ12]
PE15.Signal=FMC_D12_DA12
PE2.GPIO_Label=PDM1_CLK
PE2.Signal=SAI4_CK1
PE3.GPIO_Label=SAI1_SDB [WM8994ECS_ADCDAT1]
PE3.Mode=SAI_B_SyncSlave
PE3.Signal=SAI1_SD_B
PE4.GPIO_Label=SAI1_FSA [WM8994ECS_LRCLK1]
PE4.Mode=SAI_A_MasterWithClock
PE4.Signal=SAI1_FS_A
PE5.GPIO_Label=SAI1_SCKA [WM8994ECS_BCK1]
PE5.Mode=SAI_A_MasterWithClock
PE5.Signal=SAI1_SCK_A
PE6.GPIO_Label=SAI1_SDA [WM8994ECS_DACDAT1]
PE6.Mode=SAI_A_MasterWithClock
PE6.Signal=SAI1_SD_A
PE7.GPIO_Label=D4 [IS42S32800G_DQ4]
PE7.Signal=FMC_D4_DA4
PE8.GPIO_Label=D5 [IS42S32800G_DQ5]
PE8.Signal=FMC_D5_DA5
PE9.GPIO_Label=D6 [IS42S32800G_DQ6]
PE9.Signal=FMC_D6_DA6
PF0.GPIO_Label=A0 [PC28F128M29EWLA_A0]
PF0.Signal=FMC_A0
PF1.GPIO_Label=A1 [PC28F128M29EWLA_A1]
PF1.Signal=FMC_A1
PF10.GPIO_Label=LED1_RGB [LD1_Green]
PF10.Signal=GPIO_Output
PF11.GPIO_Label=SNDRAS [IS42S32800G_RAS]
PF11.Signal=FMC_SDNRAS
PF12.GPIO_Label=A6 [PC28F128M29EWLA_A6]
PF12.Signal=FMC_A6
PF13.GPIO_Label=A7 [PC28F128M29EWLA_A7]
PF13.Signal=FMC_A7
PF14.GPIO_Label=A8 [PC28F128M29EWLA_A8]
PF14.Signal=FMC_A8
PF15.GPIO_Label=A9 [PC28F128M29EWLA_A9]
PF15.Signal=FMC_A9
PF2.GPIO_Label=A2 [PC28F128M29EWLA_A2]
PF2.Signal=FMC_A2
PF3.GPIO_Label=A3 [PC28F128M29EWLA_A3]
PF3.Signal=FMC_A3
PF4.GPIO_Label=A4 [PC28F128M29EWLA_A4]
PF4.Signal=FMC_A4
PF5.GPIO_Label=A5 [PC28F128M29EWLA_A5]
PF5.Signal=FMC_A5
PF6.GPIO_Label=QSPI_BK1_IO3 [MT25TL01GHBA8ESF_DQ3]
PF6.Mode=Dual_Bank
PF6.Signal=QUADSPI_BK1_IO3
PF7.GPIO_Label=QSPI_BK1_IO2 [MT25TL01GHBA8ESF_DQ2]
PF7.Mode=Dual_Bank
PF7.Signal=QUADSPI_BK1_IO2
PF8.GPIO_Label=QSPI_BK1_IO0 [MT25TL01GHBA8ESF_DQ0]
PF8.Mode=Dual_Bank
PF8.Signal=QUADSPI_BK1_IO0
PF9.GPIO_Label=QSPI_BK1_IO1 [MT25TL01GHBA8ESF_DQ1]
PF9.Mode=Dual_Bank
PF9.Signal=QUADSPI_BK1_IO1
PG0.GPIO_Label=A10 [PC28F128M29EWLA_A10]
PG0.Signal=FMC_A10
PG1.GPIO_Label=A11 [PC28F128M29EWLA_A11]
PG1.Signal=FMC_A11
PG10.GPIO_Label=FMC_NE3 [IS61WV102416BLL_CE]
PG10.Mode=NorPsramChipSelect3_2
PG10.Signal=FMC_NE3
PG11.GPIO_Label=RMII_TX_EN [LAN8742A_TXEN]
PG11.Mode=RMII
PG11.Signal=ETH_TX_EN
PG12.GPIO_Label=RMII_TXD1 [LAN8742A_TXD1]
PG12.Mode=RMII
PG12.Signal=ETH_TXD1
PG13.GPIO_Label=RMII_TXD0 [LAN8742A_TXD0]
PG13.Mode=RMII
PG13.Signal=ETH_TXD0
PG14.GPIO_Label=QSPI_BK2_IO3 [MT25TL01GHBA8ESF_DQ7]
PG14.Mode=Dual_Bank
PG14.Signal=QUADSPI_BK2_IO3
PG15.GPIO_Label=SDNCAS [IS42S32800G_CAS]
PG15.Signal=FMC_SDNCAS
PG2.GPIO_Label=A12 [PC28F128M29EWLA_A12]
PG2.Signal=FMC_A12
PG3.GPIO_Label=A13 [PC28F128M29EWLA_A13]
PG3.Signal=FMC_A13
PG4.Signal=FMC_A14_BA0
PG5.Signal=FMC_A15_BA1
PG6.GPIO_Label=QSPI_BK1_NCS [MT25TL01GHBA8ESF_CS]
PG6.Mode=Enable Chip Select 1 for both banks
PG6.Signal=QUADSPI_BK1_NCS
PG7.GPIO_Label=SAI1_MCLKA [WM8994ECS_MCLK1]
PG7.Mode=SAI_A_MasterWithClock
PG7.Signal=SAI1_MCLK_A
PG8.GPIO_Label=SDCLK [IS42S32800G_CLK]
PG8.Signal=FMC_SDCLK
PG9.GPIO_Label=QSPI_BK2_IO2 [MT25TL01GHBA8ESF_DQ6]
PG9.Mode=Dual_Bank
PG9.Signal=QUADSPI_BK2_IO2
PH0-OSC_IN\ (PH0).Mode=HSE-External-Oscillator
PH0-OSC_IN\ (PH0).Signal=RCC_OSC_IN
PH1-OSC_OUT\ (PH1).Mode=HSE-External-Oscillator
PH1-OSC_OUT\ (PH1).Signal=RCC_OSC_OUT
PH10.GPIO_Label=D18 [IS42S32800G_DQ18]
PH10.Signal=FMC_D18
PH11.GPIO_Label=D19 [IS42S32800G_DQ19]
PH11.Signal=FMC_D19
PH12.GPIO_Label=D20 [IS42S32800G_DQ20]
PH12.Signal=FMC_D20
PH13.GPIO_Label=D21 [IS42S32800G_DQ21]
PH13.Signal=FMC_D21
PH14.GPIO_Label=D22 [IS42S32800G_DQ22]
PH14.Signal=FMC_D22
PH15.GPIO_Label=D23 [IS42S32800G_DQ23]
PH15.Signal=FMC_D23
PH2.GPIO_Label=QSPI_BK2_IO0 [MT25TL01GHBA8ESF_DQ4]
PH2.Mode=Dual_Bank
PH2.Signal=QUADSPI_BK2_IO0
PH3.GPIO_Label=QSPI_BK2_IO1 [MT25TL01GHBA8ESF_DQ5]
PH3.Mode=Dual_Bank
PH3.Signal=QUADSPI_BK2_IO1
PH4.GPIO_Label=ULPI_NXT [USB3320C_NXT]
PH4.Mode=Device_HS
PH4.Signal=USB_OTG_HS_ULPI_NXT
PH5.GPIO_Label=SDNWE [IS42S32800G_WE]
PH5.Signal=FMC_SDNWE
PH6.GPIO_Label=SDNE1 [IS42S32800G_CS]
PH6.Mode=SdramChipSelect2_1
PH6.Signal=FMC_SDNE1
PH7.GPIO_Label=SDCKE1 [IS42S32800G_CKE]
PH7.Mode=SdramChipSelect2_1
PH7.Signal=FMC_SDCKE1
PH8.GPIO_Label=D16 [IS42S32800G_DQ16]
PH8.Signal=FMC_D16
PH9.GPIO_Label=D17 [IS42S32800G_DQ17]
PH9.Signal=FMC_D17
PI0.GPIO_Label=D24 [IS42S32800G_DQ24]
PI0.Signal=FMC_D24
PI1.GPIO_Label=D25 [IS42S32800G_DQ25]
PI1.Signal=FMC_D25
PI10.GPIO_Label=D31 [IS42S32800G_DQ31]
PI10.Signal=FMC_D31
PI11.GPIO_Label=ULPI_DIR [USB3320C_DIR]
PI11.Mode=Device_HS
PI11.Signal=USB_OTG_HS_ULPI_DIR
PI12.GPIO_Label=LCD_HSYNC
PI12.GPIO_Speed=GPIO_SPEED_FREQ_VERY_HIGH
PI12.Mode=RGB888
PI12.Signal=LTDC_HSYNC
PI13.GPIO_Label=LCD_VSYNC
PI13.GPIO_Speed=GPIO_SPEED_FREQ_VERY_HIGH
PI13.Mode=RGB888
PI13.Signal=LTDC_VSYNC
PI14.GPIO_Label=LCD_CLK
PI14.GPIO_Speed=GPIO_SPEED_FREQ_VERY_HIGH
PI14.Mode=RGB888
PI14.Signal=LTDC_CLK
PI15.GPIO_Label=LCD_R0
PI15.GPIO_Speed=GPIO_SPEED_FREQ_VERY_HIGH
PI15.Mode=RGB888
PI15.Signal=LTDC_R0
PI2.GPIO_Label=D26 [IS42S32800G_DQ26]
PI2.Signal=FMC_D26
PI3.GPIO_Label=D27 [IS42S32800G_DQ27
PI3.Signal=FMC_D27
PI4.GPIO_Label=FMC_NBL2 [IS42S32800G_DQM2]
PI4.Signal=FMC_NBL2
PI5.GPIO_Label=FMC_NBL3 [IS42S32800G_DQM3]
PI5.Signal=FMC_NBL3
PI6.GPIO_Label=D28 [IS42S32800G_DQ28]
PI6.Signal=FMC_D28
PI7.GPIO_Label=D29 [IS42S32800G_DQ29]
PI7.Signal=FMC_D29
PI8.GPIO_Label=MFX_IRQOUT [MFX_V3_IRQOUT]
PI8.Signal=GPXTI8
PI9.GPIO_Label=D30 [IS42S32800G_DQ30]
PI9.Signal=FMC_D30
PJ0.GPIO_Label=LCD_R1
PJ0.GPIO_Speed=GPIO_SPEED_FREQ_VERY_HIGH
PJ0.Mode=RGB888
PJ0.Signal=LTDC_R1
PJ1.GPIO_Label=LCD_R2
PJ1.GPIO_Speed=GPIO_SPEED_FREQ_VERY_HIGH
PJ1.Mode=RGB888
PJ1.Signal=LTDC_R2
PJ10.GPIO_Label=LCd_G3
PJ10.GPIO_Speed=GPIO_SPEED_FREQ_VERY_HIGH
PJ10.Mode=RGB888
PJ10.Signal=LTDC_G3
PJ11.GPIO_Label=LCD_G4
PJ11.GPIO_Speed=GPIO_SPEED_FREQ_VERY_HIGH
PJ11.Mode=RGB888
PJ11.Signal=LTDC_G4
PJ12.GPIO_Label=LCD_B0
PJ12.GPIO_Speed=GPIO_SPEED_FREQ_VERY_HIGH
PJ12.Mode=RGB888
PJ12.Signal=LTDC_B0
PJ13.GPIO_Label=LCD_B1
PJ13.GPIO_Speed=GPIO_SPEED_FREQ_VERY_HIGH
PJ13.Mode=RGB888
PJ13.Signal=LTDC_B1
PJ14.GPIO_Label=LCD_B2
PJ14.GPIO_Speed=GPIO_SPEED_FREQ_VERY_HIGH
PJ14.Mode=RGB888
PJ14.Signal=LTDC_B2
PJ15.GPIO_Label=LCD_B3
PJ15.GPIO_Speed=GPIO_SPEED_FREQ_VERY_HIGH
PJ15.Mode=RGB888
PJ15.Signal=LTDC_B3
PJ2.GPIO_Label=LCD_R3
PJ2.GPIO_Speed=GPIO_SPEED_FREQ_VERY_HIGH
PJ2.Mode=RGB888
PJ2.Signal=LTDC_R3
PJ3.GPIO_Label=LCD_R4
PJ3.GPIO_Speed=GPIO_SPEED_FREQ_VERY_HIGH
PJ3.Mode=RGB888
PJ3.Signal=LTDC_R4
PJ4.GPIO_Label=LCD_R5
PJ4.GPIO_Speed=GPIO_SPEED_FREQ_VERY_HIGH
PJ4.Mode=RGB888
PJ4.Signal=LTDC_R5
PJ5.GPIO_Label=LCD_R6
PJ5.GPIO_Speed=GPIO_SPEED_FREQ_VERY_HIGH
PJ5.Mode=RGB888
PJ5.Signal=LTDC_R6
PJ6.GPIO_Label=LCD_R7
PJ6.GPIO_Speed=GPIO_SPEED_FREQ_VERY_HIGH
PJ6.Mode=RGB888
PJ6.Signal=LTDC_R7
PJ7.GPIO_Label=LCD_G0
PJ7.GPIO_Speed=GPIO_SPEED_FREQ_VERY_HIGH
PJ7.Mode=RGB888
PJ7.Signal=LTDC_G0
PJ8.GPIO_Label=LCD_G1
PJ8.GPIO_Speed=GPIO_SPEED_FREQ_VERY_HIGH
PJ8.Mode=RGB888
PJ8.Signal=LTDC_G1
PJ9.GPIO_Label=LCD_G2
PJ9.GPIO_Speed=GPIO_SPEED_FREQ_VERY_HIGH
PJ9.Mode=RGB888
PJ9.Signal=LTDC_G2
PK0.GPIO_Label=LCD_G5
PK0.GPIO_Speed=GPIO_SPEED_FREQ_VERY_HIGH
PK0.Mode=RGB888
PK0.Signal=LTDC_G5
PK1.GPIO_Label=LCD_G6
PK1.GPIO_Speed=GPIO_SPEED_FREQ_VERY_HIGH
PK1.Mode=RGB888
PK1.Signal=LTDC_G6
PK2.GPIO_Label=LCD_G7
PK2.GPIO_Speed=GPIO_SPEED_FREQ_VERY_HIGH
PK2.Mode=RGB888
PK2.Signal=LTDC_G7
PK3.GPIO_Label=LCD_B4
PK3.GPIO_Speed=GPIO_SPEED_FREQ_VERY_HIGH
PK3.Mode=RGB888
PK3.Signal=LTDC_B4
PK4.GPIO_Label=LCD_B5
PK4.GPIO_Speed=GPIO_SPEED_FREQ_VERY_HIGH
PK4.Mode=RGB888
PK4.Signal=LTDC_B5
PK5.GPIO_Label=LCD_B6
PK5.GPIO_Speed=GPIO_SPEED_FREQ_VERY_HIGH
PK5.Mode=RGB888
PK5.Signal=LTDC_B6
PK6.GPIO_Label=LCD_B7
PK6.GPIO_Speed=GPIO_SPEED_FREQ_VERY_HIGH
PK6.Mode=RGB888
PK6.Signal=LTDC_B7
PK7.GPIO_Speed=GPIO_SPEED_FREQ_VERY_HIGH
PK7.Mode=RGB888
PK7.Signal=LTDC_DE
ProjectManager.HeapSize=0x200
ProjectManager.StackSize=0x400
ProjectManager.TargetToolchain=STM32CubeIDE
RCC.ADCFreq_Value=160000000
RCC.APB1Freq_Value=80000000
RCC.APB2Freq_Value=20000000
RCC.APB3Freq_Value=80000000
RCC.APB4Freq_Value=80000000
RCC.CortexFreq_Value=80000000
RCC.D2PPRE2=RCC_APB2_DIV4
RCC.DIVM1=4
RCC.DIVM2=4
RCC.DIVN1=10
RCC.DIVN2=10
RCC.DIVP2=1
RCC.DIVQ1=4
RCC.HCLKFreq_Value=80000000
RCC.SYSCLKFreq_VALUE=80000000
RCC.SYSCLKSource=RCC_SYSCLKSOURCE_PLLCLK
RCC.USBCLockSelection=RCC_USBCLKSOURCE_HSI48
RCC.USBFreq_Value=48000000
SAI1.ErrorAudioFreq-SAI_A_MasterWithClock=-18.61 %
SAI1.Instance-SAI_A_MasterWithClock=SAI$Index_Block_A
SAI1.Instance-SAI_B_SyncSlave=SAI$Index_Block_B
SAI1.MClockEnable-SAI_A_MasterWithClock=SAI_MASTERCLOCK_ENABLE
SAI1.RealAudioFreq-SAI_A_MasterWithClock=156.25 KHz
SAI1.VirtualMode-SAI_A_MasterWithClock=VM_MASTER
SAI1.VirtualMode-SAI_B_SyncSlave=VM_SLAVE
SH.ADCx_INN1.0=ADC1_INN1,IN1-Differential
SH.ADCx_INP1.0=ADC1_INP1,IN1-Differential
SH.FMC_A0.0=FMC_A0,11b-sda1
SH.FMC_A0.1=FMC_A0,19b-a1
SH.FMC_A0.2=FMC_A0,19b-a2
SH.FMC_A1.0=FMC_A1,11b-sda1
SH.FMC_A1.1=FMC_A1,19b-a1
SH.FMC_A1.2=FMC_A1,19b-a2
SH.FMC_A10.0=FMC_A10,11b-sda1
SH.FMC_A10.1=FMC_A10,19b-a1
SH.FMC_A10.2=FMC_A10,19b-a2
SH.FMC_A11.0=FMC_A11,19b-a1
SH.FMC_A11.1=FMC_A11,19b-a2
SH.FMC_A12.0=FMC_A12,19b-a1
SH.FMC_A12.1=FMC_A12,19b-a2
SH.FMC_A13.0=FMC_A13,19b-a1
SH.FMC_A13.1=FMC_A13,19b-a2
SH.FMC_A14_BA0.0=FMC_BA0,FourSdramBanks1
SH.FMC_A14_BA0.1=FMC_A14,19b-a1
SH.FMC_A14_BA0.2=FMC_A14,19b-a2
SH.FMC_A15_BA1.0=FMC_BA1,FourSdramBanks1
SH.FMC_A15_BA1.1=FMC_A15,19b-a1
SH.FMC_A15_BA1.2=FMC_A15,19b-a2
SH.FMC_A16_CLE.0=FMC_A16,19b-a1
SH.FMC_A16_CLE.1=FMC_A16,19b-a2
SH.FMC_A17_ALE.0=FMC_A17,19b-a1
SH.FMC_A17_ALE.1=FMC_A17,19b-a2
SH.FMC_A18.0=FMC_A18,19b-a1
SH.FMC_A18.1=FMC_A18,19b-a2
SH.FMC_A2.0=FMC_A2,11b-sda1
SH.FMC_A2.1=FMC_A2,19b-a1
SH.FMC_A2.2=FMC_A2,19b-a2
SH.FMC_A3.0=FMC_A3,11b-sda1
SH.FMC_A3.1=FMC_A3,19b-a1
SH.FMC_A3.2=FMC_A3,19b-a2
SH.FMC_A4.0=FMC_A4,11b-sda1
SH.FMC_A4.1=FMC_A4,19b-a1
SH.FMC_A4.2=FMC_A4,19b-a2
SH.FMC_A5.0=FMC_A5,11b-sda1
SH.FMC_A5.1=FMC_A5,19b-a1
SH.FMC_A5.2=FMC_A5,19b-a2
SH.FMC_A6.0=FMC_A6,11b-sda1
SH.FMC_A6.1=FMC_A6,19b-a1
SH.FMC_A6.2=FMC_A6,19b-a2
SH.FMC_A7.0=FMC_A7,11b-sda1
SH.FMC_A7.1=FMC_A7,19b-a1
SH.FMC_A7.2=FMC_A7,19b-a2
SH.FMC_A8.0=FMC_A8,11b-sda1
SH.FMC_A8.1=FMC_A8,19b-a1
SH.FMC_A8.2=FMC_A8,19b-a2
SH.FMC_A9.0=FMC_A9,11b-sda1
SH.FMC_A9.1=FMC_A9,19b-a1
SH.FMC_A9.2=FMC_A9,19b-a2
SH.FMC_D0_DA0.0=FMC_D0,sd-32b-d1
SH.FMC_D0_DA0.1=FMC_D0,16b-d1
SH.FMC_D0_DA0.2=FMC_D0,16b-d2
SH.FMC_D10_DA10.0=FMC_D10,sd-32b-d1
SH.FMC_D10_DA10.1=FMC_D10,16b-d1
SH.FMC_D10_DA10.2=FMC_D10,16b-d2
SH.FMC_D11_DA11.0=FMC_D11,sd-32b-d1
SH.FMC_D11_DA11.1=FMC_D11,16b-d1
SH.FMC_D11_DA11.2=FMC_D11,16b-d2
SH.FMC_D12_DA12.0=FMC_D12,sd-32b-d1
SH.FMC_D12_DA12.1=FMC_D12,16b-d1
SH.FMC_D12_DA12.2=FMC_D12,16b-d2
SH.FMC_D13_DA13.0=FMC_D13,sd-32b-d1
SH.FMC_D13_DA13.1=FMC_D13,16b-d1
SH.FMC_D13_DA13.2=FMC_D13,16b-d2
SH.FMC_D14_DA14.0=FMC_D14,sd-32b-d1
SH.FMC_D14_DA14.1=FMC_D14,16b-d1
SH.FMC_D14_DA14.2=FMC_D14,16b-d2
SH.FMC_D15_DA15.0=FMC_D15,sd-32b-d1
SH.FMC_D15_DA15.1=FMC_D15,16b-d1
SH.FMC_D15_DA15.2=FMC_D15,16b-d2
SH.FMC_D16.0=FMC_D16,sd-32b-d1
SH.FMC_D17.0=FMC_D17,sd-32b-d1
SH.FMC_D18.0=FMC_D18,sd-32b-d1
SH.FMC_D19.0=FMC_D19,sd-32b-d1
SH.FMC_D1_DA1.0=FMC_D1,sd-32b-d1
SH.FMC_D1_DA1.1=FMC_D1,16b-d1
SH.FMC_D1_DA1.2=FMC_D1,16b-d2
SH.FMC_D20.0=FMC_D20,sd-32b-d1
SH.FMC_D21.0=FMC_D21,sd-32b-d1
SH.FMC_D22.0=FMC_D22,sd-32b-d1
SH.FMC_D23.0=FMC_D23,sd-32b-d1
SH.FMC_D24.0=FMC_D24,sd-32b-d1
SH.FMC_D25.0=FMC_D25,sd-32b-d1
SH.FMC_D26.0=FMC_D26,sd-32b-d1
SH.FMC_D27.0=FMC_D27,sd-32b-d1
SH.FMC_D28.0=FMC_D28,sd-32b-d1
SH.FMC_D29.0=FMC_D29,sd-32b-d1
SH.FMC_D2_DA2.0=FMC_D2,sd-32b-d1
SH.FMC_D2_DA2.1=FMC_D2,16b-d1
SH.FMC_D2_DA2.2=FMC_D2,16b-d2
SH.FMC_D30.0=FMC_D30,sd-32b-d1
SH.FMC_D31.0=FMC_D31,sd-32b-d1
SH.FMC_D3_DA3.0=FMC_D3,sd-32b-d1
SH.FMC_D3_DA3.1=FMC_D3,16b-d1
SH.FMC_D3_DA3.2=FMC_D3,16b-d2
SH.FMC_D4_DA4.0=FMC_D4,sd-32b-d1
SH.FMC_D4_DA4.1=FMC_D4,16b-d1
SH.FMC_D4_DA4.2=FMC_D4,16b-d2
SH.FMC_D5_DA5.0=FMC_D5,sd-32b-d1
SH.FMC_D5_DA5.1=FMC_D5,16b-d1
SH.FMC_D5_DA5.2=FMC_D5,16b-d2
SH.FMC_D6_DA6.0=FMC_D6,sd-32b-d1
SH.FMC_D6_DA6.1=FMC_D6,16b-d1
SH.FMC_D6_DA6.2=FMC_D6,16b-d2
SH.FMC_D7_DA7.0=FMC_D7,sd-32b-d1
SH.FMC_D7_DA7.1=FMC_D7,16b-d1
SH.FMC_D7_DA7.2=FMC_D7,16b-d2
SH.FMC_D8_DA8.0=FMC_D8,sd-32b-d1
SH.FMC_D8_DA8.1=FMC_D8,16b-d1
SH.FMC_D8_DA8.2=FMC_D8,16b-d2
SH.FMC_D9_DA9.0=FMC_D9,sd-32b-d1
SH.FMC_D9_DA9.1=FMC_D9,16b-d1
SH.FMC_D9_DA9.2=FMC_D9,16b-d2
SH.FMC_NBL0.0=FMC_NBL0,2ByteEnable2
SH.FMC_NBL0.1=FMC_NBL0,Sd4ByteEnable1
SH.FMC_NBL1.0=FMC_NBL1,2ByteEnable2
SH.FMC_NBL1.1=FMC_NBL1,Sd4ByteEnable1
SH.FMC_NBL2.0=FMC_NBL2,Sd4ByteEnable1
SH.FMC_NBL3.0=FMC_NBL3,Sd4ByteEnable1
SH.FMC_NOE.0=FMC_NOE,NorFlash1
SH.FMC_NOE.1=FMC_NOE,Sram2
SH.FMC_NWAIT.0=FMC_NWAIT,AsynchronousWait1
SH.FMC_NWAIT.1=FMC_NWAIT,AsynchronousWait2
SH.FMC_NWE.0=FMC_NWE,NorFlash1
SH.FMC_NWE.1=FMC_NWE,Sram2
SH.FMC_SDCLK.0=FMC_SDCLK,11b-sda1
SH.FMC_SDNCAS.0=FMC_SDNCAS,11b-sda1
SH.FMC_SDNRAS.0=FMC_SDNRAS,11b-sda1
SH.FMC_SDNWE.0=FMC_SDNWE,11b-sda1
SH.S_CKOUTDFSDM1.0=DFSDM1_CKOUT,PDM_SPI_input_from_ch1_and_internal_clock
SH.S_CKOUTDFSDM1.1=DFSDM1_CKOUT,CKOUT
SH.S_DATAIN1DFSDM1.0=DFSDM1_DATIN1,PDM_SPI_input_from_ch1_and_internal_clock
USART1.VirtualMode-Asynchronous=VM_ASYNC
USB_OTG_FS.VirtualMode=Device_Only
USB_OTG_HS.VirtualMode-Device_HS=Device_HS
board=STM32H753I-EVAL2

// file: Core/Src/main.c
/* USER CODE BEGIN Header */
/**
  ******************************************************************************
  * @file           : main.c
  * @brief          : Main program body
  ******************************************************************************
  * @attention
  *
  * <h2><center>&copy; Copyright (c) 2020 STMicroelectronics.
  * All rights reserved.</center></h2>
  *
  * This software component is licensed by ST under BSD 3-Clause license,
  * the "License"; You may not use this file except in compliance with the
  * License. You may obtain a copy of the License at:
  *                        opensource.org/licenses/BSD-3-Clause
  *
  ******************************************************************************
  */
/* USER CODE END Header */

#include "main.h"
#include "string.h"

/* USER CODE BEGIN Includes */
#include "Image.h"
/* USER CODE END Includes */

/* USER CODE BEGIN PD */
#define DISPLAY_WIDTH	((uint16_t)640)
#define DISPLAY_HEIGHT	((uint16_t)480)
/* USER CODE END PD */

#if defined ( __ICCARM__ ) /*!< IAR Compiler */

#pragma location=0x30040000
ETH_DMADescTypeDef  DMARxDscrTab[ETH_RX_DESC_CNT]; /* Ethernet Rx DMA Descriptors */
#pragma location=0x30040060
ETH_DMADescTypeDef  DMATxDscrTab[ETH_TX_DESC_CNT]; /* Ethernet Tx DMA Descriptors */
#pragma location=0x30040200
uint8_t Rx_Buff[ETH_RX_DESC_CNT][ETH_MAX_PACKET_SIZE]; /* Ethernet Receive Buffers */

#elif defined ( __CC_ARM )  /* MDK ARM Compiler */

__attribute__((at(0x30040000))) ETH_DMADescTypeDef  DMARxDscrTab[ETH_RX_DESC_CNT]; /* Ethernet Rx DMA Descriptors */
__attribute__((at(0x30040060))) ETH_DMADescTypeDef  DMATxDscrTab[ETH_TX_DESC_CNT]; /* Ethernet Tx DMA Descriptors */
__attribute__((at(0x30040200))) uint8_t Rx_Buff[ETH_RX_DESC_CNT][ETH_MAX_PACKET_SIZE]; /* Ethernet Receive Buffer */

#elif defined ( __GNUC__ ) /* GNU Compiler */

ETH_DMADescTypeDef DMARxDscrTab[ETH_RX_DESC_CNT] __attribute__((section(".RxDecripSection"))); /* Ethernet Rx DMA Descriptors */
ETH_DMADescTypeDef DMATxDscrTab[ETH_TX_DESC_CNT] __attribute__((section(".TxDecripSection")));   /* Ethernet Tx DMA Descriptors */
uint8_t Rx_Buff[ETH_RX_DESC_CNT][ETH_MAX_PACKET_SIZE] __attribute__((section(".RxArraySection"))); /* Ethernet Receive Buffers */

#endif

ETH_TxPacketConfig TxConfig;
ADC_HandleTypeDef hadc1;

DFSDM_Channel_HandleTypeDef hdfsdm1_channel1;

ETH_HandleTypeDef heth;

I2C_HandleTypeDef hi2c1;

LTDC_HandleTypeDef hltdc;

QSPI_HandleTypeDef hqspi;

SAI_HandleTypeDef hsai_BlockA1;
SAI_HandleTypeDef hsai_BlockB1;

SD_HandleTypeDef hsd1;

UART_HandleTypeDef huart1;

PCD_HandleTypeDef hpcd_USB_OTG_FS;
PCD_HandleTypeDef hpcd_USB_OTG_HS;

NOR_HandleTypeDef hnor1;
SRAM_HandleTypeDef hsram2;
SDRAM_HandleTypeDef hsdram1;

/* USER CODE BEGIN PV */
//const uint32_t imageLayer[DISPLAY_WIDTH * DISPLAY_HEIGHT];
//uint32_t imageLayer[DISPLAY_WIDTH * DISPLAY_HEIGHT];
//uint32_t pokus[640*480];

//uint32_t pokus[307200]; // 307200*4 Bytu = 1 228 800 Bytu = 1.3 kB
//__attribute__((section(".RAM_D3"))) uint32_t pokus[307200];

//uint32_t pokus[307200];

// 0x2400 0a34 addr ?
//const uint32_t pokus[307200];

__attribute__((section("FLASH"))) uint32_t pokus[307200];

//uint32_t test[300000];
// bez
// text 53300
// data 216
// bss 5096
// dec 58612
// hex e4f4

// s jednim lokalnim
// text 53364
// data 216
// bss 5096
// dec 58676
// hex e534

// s jednim globalnim
// text 53364
// data 216
// bss 5096
// dec 58676
// hex e534

/* USER CODE END PV */

void SystemClock_Config(void);
static void MX_GPIO_Init(void);
static void MX_ADC1_Init(void);
static void MX_DFSDM1_Init(void);
static void MX_ETH_Init(void);
static void MX_FMC_Init(void);
static void MX_I2C1_Init(void);
static void MX_QUADSPI_Init(void);
static void MX_SAI1_Init(void);
static void MX_SDMMC1_SD_Init(void);
static void MX_USART1_UART_Init(void);
static void MX_USB_OTG_FS_PCD_Init(void);
static void MX_USB_OTG_HS_PCD_Init(void);
static void MX_LTDC_Init(void);

int main(void)
{

  /* MCU Configuration--------------------------------------------------------*/

  /* Reset of all peripherals, Initializes the Flash interface and the Systick. */
  HAL_Init();

  /* Configure the system clock */
  SystemClock_Config();

  /* Initialize all configured peripherals */
  MX_GPIO_Init();
  MX_ADC1_Init();
  MX_DFSDM1_Init();
  MX_ETH_Init();
  MX_FMC_Init();
  MX_I2C1_Init();
  MX_QUADSPI_Init();
  MX_SAI1_Init();
  MX_SDMMC1_SD_Init();
  MX_USART1_UART_Init();
  MX_USB_OTG_FS_PCD_Init();
  MX_USB_OTG_HS_PCD_Init();
  MX_LTDC_Init();
  /* USER CODE BEGIN 2 */

  // Enable LTDC Peripheral clock
  // RCC_APB3ENR registr
  // 0 - X
  // 1 - X
  // 2 - X
  // 3 - 0 LTDC clock disabled (DEF) / 1 enabled
  // 4 - X
  // 5 - X
  // 6 - WWDG1 Clock 0 disabled (DEF) / 1 enabled
  // 7 - X
  //
  // 0100 1000 =  0x48 = 72 dec
  // RCC_APB3ENR = 0x48;
  // nebo
  //RCC->APB3LPENR |= RCC_APB3ENR_LTDCEN;

  // Turn on clock source from quartz resonator and wait for ready
  // HSE - High Speed External oscillator - 4 to 48 MHz
  // RCC Source Control Register (RCC_CR)
  // bit 16 HSEON - 0 off (DEF) / 1  - on zapne ext osci
  // bit 19 HSECSSON -  HSE Clock Security System - 0 off (DEF) / 1 on
  // bit 17 HSERDY - Set by HW to indicate that HSE osc is stable
  //RCC->CR |= RCC_CR_HSEON;
  //while(!(RCC->CR & RCC_CR_HSERDY));

  // Delay for flash memory ?????
  //FLASH->ACR |= FLASH_ACR_LATENCY_5WS;

  //Now, to get the desired frequency, I divide 25 MHz from the input by 25 and get 1 MHz. Further, just in PLL I multiply by 432, because In the future, there is a frequency divider with a minimum value of / 2 and you need to apply a double frequency to it. After that, we connect the PLL input to our quartz resonator (HSE):
  // ale hodiny mame snad vyreseny - vygenerovano

  // Ted zapne clocking na vsech GPIO, ale to asi nepotrebujeme
  // to mame vygenerovano

  // Ted nastavi vsechny piny pro LTDC jako Alternative output a High Frequency
  // asi taky mame, ale nic to nevygenerovalo

  // Vytvorime pamet pro framebuffer

  int popo = 1;

  //const uint32_t imageLayer[DISPLAY_WIDTH * DISPLAY_HEIGHT];
  //uint32_t imageLayer[DISPLAY_WIDTH * DISPLAY_HEIGHT];

  //uint32_t pokus[640*100]; //53580 Bytes
  //uint32_t pokus[640*1000]; //
  // 640x480 = 307 200;
//  uint32_t test[300000];
//  uint32_t test2[300000];
  // s obema
  // text 53364
  // data 216
  // bss 5096
  // dec 58676
  // hex e534

  // s jednim
  // text 53364
  // data 216
  // bss 5096
  // dec 58676
  // hex e534

  // stejny

  int xu = 3;

  // Rekneme LTDC ze na ty adrese ma framebuffer pro prvni vrstvu

  //LTDC_Layer1->CFBAR = (uint32_t)imageLayer;

  // Nastavime alphu ty prvni vrstvy 0-pruhledna 255-plna

  //LTDC_Layer1->CACR = 255;

  // Default color of layer
  //LTDC_Layer1->DCCR =0x00F0; // snad zelena

  //LTDC_Layer1->DCCR = 0x00FF0000;

  // LTDC background color configuration register (LTDC_BCCR)
  // Totalni pozadi pod obouma vrstvama
  // Bits 31:24 Reserved, must be kept at reset value.
  // Bits 23:16 BCRED[7:0]: background color red value
  // These bits configure the background red value.
  // Bits 15:8 BCGREEN[7:0]: background color green value
  // These bits configure the background green value.
  // Bits 7:0 BCBLUE[7:0]: background color blue value
  // These bits configure the background blue value.
  //LTDC_BCCR = 0x0F00; // Snad cervena :)

  //LTDC->BCCR = 0x0000FF00;

  // LTDC layer x color keying configuration register
  // (LTDC_LxCKCR)

  // Mozna este nastavit velikost visible arey v bytech
  //LTDC_Layer1->CFBLR |= (((PIXEL_SIZE * DISPLAY_WIDTH) << 16) | (PIXEL_SIZE * DISPLAY_WIDTH + 3));
  //LTDC_Layer1->CFBLNR |= DISPLAY_HEIGHT;

  //The last two steps remain, namely the inclusion of layer No. 2 and the periphery module LTDC itself. To do this, write the corresponding bits:
  //LTDC_Layer2->CR |= LTDC_LxCR_LEN;
  //LTDC->GCR |= LTDC_GCR_LTDCEN;

  // LTDC global control register (LTDC_GCR)
  //Bit 31 HSPOL: horizontal synchronization polarity
  //This bit is set and cleared by software.
  //0: horizontal synchronization polarity is active low.
  //1: horizontal synchronization polarity is active high.
  //Bit 30 VSPOL: vertical synchronization polarity
  //This bit is set and cleared by software.
  //0: vertical synchronization is active low.
  //1: vertical synchronization is active high.
  //Bit 29 DEPOL: not data enable polarity
  //This bit is set and cleared by software.
  //0: not data enable polarity is active low.
  //1: not data enable polarity is active high.
  //Bit 28 PCPOL: pixel clock polarity
  //This bit is set and cleared by software.
  //0: pixel clock polarity is active low.
  //1: pixel clock is active high.
  //Bits 27:17 Reserved, must be kept at reset value.
  //Bit 16 DEN: dither enable
  //This bit is set and cleared by software.
  //0: dither disable
  //1: dither enable
  //Bit 15 Reserved, must be kept at reset value.
  //Bits 14:12 DRW[2:0]: dither red width
  //These bits return the Dither Red Bits.
  //Bit 11 Reserved, must be kept at reset value.
  //Bits 10:8 DGW[2:0]: dither green width
  //These bits return the dither green bits.
  //Bit 7 Reserved, must be kept at reset value.
  //Bits 6:4 DBW[2:0]: dither blue width
  //These bits return the dither blue bits.
  //Bits 3:1 Reserved, must be kept at reset value.
  //Bit 0 LTDCEN: LCD-TFT controller enable
  //This bit is set and cleared by software.
  //0: LTDC disable
  //1: LTDC enable

  //LTDC->GCR |= LTDC_GCR_LTDCEN;

  /* USER CODE END 2 */

  /* Infinite loop */
  while (1)
  {

    /* USER CODE BEGIN 3 */
	  int a,b,c;
	  a = 1;
	  b = 2;
	  c = a + b;

	  unsigned int adr = &pokus;

	  b++;
  }
  /* USER CODE END 3 */
}

void SystemClock_Config(void)
{
  RCC_OscInitTypeDef RCC_OscInitStruct = {0};
  RCC_ClkInitTypeDef RCC_ClkInitStruct = {0};
  RCC_PeriphCLKInitTypeDef PeriphClkInitStruct = {0};

  /** Supply configuration update enable
  */
  HAL_PWREx_ConfigSupply(PWR_LDO_SUPPLY);
  /** Configure the main internal regulator output voltage
  */
  __HAL_PWR_VOLTAGESCALING_CONFIG(PWR_REGULATOR_VOLTAGE_SCALE3);

  while(!__HAL_PWR_GET_FLAG(PWR_FLAG_VOSRDY)) {}
  /** Macro to configure the PLL clock source
  */
  __HAL_RCC_PLL_PLLSOURCE_CONFIG(RCC_PLLSOURCE_HSI);
  /** Initializes the CPU, AHB and APB busses clocks
  */
  RCC_OscInitStruct.OscillatorType = RCC_OSCILLATORTYPE_HSI48|RCC_OSCILLATORTYPE_HSI;
  RCC_OscInitStruct.HSIState = RCC_HSI_DIV1;
  RCC_OscInitStruct.HSICalibrationValue = RCC_HSICALIBRATION_DEFAULT;
  RCC_OscInitStruct.HSI48State = RCC_HSI48_ON;
  RCC_OscInitStruct.PLL.PLLState = RCC_PLL_ON;
  RCC_OscInitStruct.PLL.PLLSource = RCC_PLLSOURCE_HSI;
  RCC_OscInitStruct.PLL.PLLM = 4;
  RCC_OscInitStruct.PLL.PLLN = 10;
  RCC_OscInitStruct.PLL.PLLP = 2;
  RCC_OscInitStruct.PLL.PLLQ = 4;
  RCC_OscInitStruct.PLL.PLLR = 2;
  RCC_OscInitStruct.PLL.PLLRGE = RCC_PLL1VCIRANGE_3;
  RCC_OscInitStruct.PLL.PLLVCOSEL = RCC_PLL1VCOMEDIUM;
  RCC_OscInitStruct.PLL.PLLFRACN = 0;
  if (HAL_RCC_OscConfig(&RCC_OscInitStruct) != HAL_OK)
  {
    Error_Handler();
  }
  /** Initializes the CPU, AHB and APB busses clocks
  */
  RCC_ClkInitStruct.ClockType = RCC_CLOCKTYPE_HCLK|RCC_CLOCKTYPE_SYSCLK
                              |RCC_CLOCKTYPE_PCLK1|RCC_CLOCKTYPE_PCLK2
                              |RCC_CLOCKTYPE_D3PCLK1|RCC_CLOCKTYPE_D1PCLK1;
  RCC_ClkInitStruct.SYSCLKSource = RCC_SYSCLKSOURCE_PLLCLK;
  RCC_ClkInitStruct.SYSCLKDivider = RCC_SYSCLK_DIV1;
  RCC_ClkInitStruct.AHBCLKDivider = RCC_HCLK_DIV1;
  RCC_ClkInitStruct.APB3CLKDivider = RCC_APB3_DIV1;
  RCC_ClkInitStruct.APB1CLKDivider = RCC_APB1_DIV1;
  RCC_ClkInitStruct.APB2CLKDivider = RCC_APB2_DIV4;
  RCC_ClkInitStruct.APB4CLKDivider = RCC_APB4_DIV1;

  if (HAL_RCC_ClockConfig(&RCC_ClkInitStruct, FLASH_LATENCY_1) != HAL_OK)
  {
    Error_Handler();
  }
  PeriphClkInitStruct.PeriphClockSelection = RCC_PERIPHCLK_LTDC|RCC_PERIPHCLK_USART1
                              |RCC_PERIPHCLK_DFSDM1|RCC_PERIPHCLK_SAI1
                              |RCC_PERIPHCLK_SDMMC|RCC_PERIPHCLK_ADC
                              |RCC_PERIPHCLK_I2C1|RCC_PERIPHCLK_USB
                              |RCC_PERIPHCLK_QSPI|RCC_PERIPHCLK_FMC;
  PeriphClkInitStruct.PLL2.PLL2M = 4;
  PeriphClkInitStruct.PLL2.PLL2N = 10;
  PeriphClkInitStruct.PLL2.PLL2P = 1;
  PeriphClkInitStruct.PLL2.PLL2Q = 2;
  PeriphClkInitStruct.PLL2.PLL2R = 2;
  PeriphClkInitStruct.PLL2.PLL2RGE = RCC_PLL2VCIRANGE_3;
  PeriphClkInitStruct.PLL2.PLL2VCOSEL = RCC_PLL2VCOMEDIUM;
  PeriphClkInitStruct.PLL2.PLL2FRACN = 0;
  PeriphClkInitStruct.PLL3.PLL3M = 32;
  PeriphClkInitStruct.PLL3.PLL3N = 129;
  PeriphClkInitStruct.PLL3.PLL3P = 2;
  PeriphClkInitStruct.PLL3.PLL3Q = 2;
  PeriphClkInitStruct.PLL3.PLL3R = 2;
  PeriphClkInitStruct.PLL3.PLL3RGE = RCC_PLL3VCIRANGE_1;
  PeriphClkInitStruct.PLL3.PLL3VCOSEL = RCC_PLL3VCOWIDE;
  PeriphClkInitStruct.PLL3.PLL3FRACN = 0;
  PeriphClkInitStruct.FmcClockSelection = RCC_FMCCLKSOURCE_D1HCLK;
  PeriphClkInitStruct.QspiClockSelection = RCC_QSPICLKSOURCE_D1HCLK;
  PeriphClkInitStruct.SdmmcClockSelection = RCC_SDMMCCLKSOURCE_PLL;
  PeriphClkInitStruct.Sai1ClockSelection = RCC_SAI1CLKSOURCE_PLL;
  PeriphClkInitStruct.Dfsdm1ClockSelection = RCC_DFSDM1CLKSOURCE_D2PCLK1;
  PeriphClkInitStruct.Usart16ClockSelection = RCC_USART16CLKSOURCE_D2PCLK2;
  PeriphClkInitStruct.I2c123ClockSelection = RCC_I2C123CLKSOURCE_D2PCLK1;
  PeriphClkInitStruct.UsbClockSelection = RCC_USBCLKSOURCE_HSI48;
  PeriphClkInitStruct.AdcClockSelection = RCC_ADCCLKSOURCE_PLL2;
  if (HAL_RCCEx_PeriphCLKConfig(&PeriphClkInitStruct) != HAL_OK)
  {
    Error_Handler();
  }
  HAL_RCC_MCOConfig(RCC_MCO1, RCC_MCO1SOURCE_HSI, RCC_MCODIV_1);
  /** Enable USB Voltage detector
  */
  HAL_PWREx_EnableUSBVoltageDetector();
}

static void MX_ADC1_Init(void)
{

  ADC_MultiModeTypeDef multimode = {0};
  ADC_ChannelConfTypeDef sConfig = {0};

  /** Common config
  */
  hadc1.Instance = ADC1;
  hadc1.Init.ClockPrescaler = ADC_CLOCK_ASYNC_DIV1;
  hadc1.Init.Resolution = ADC_RESOLUTION_16B;
  hadc1.Init.ScanConvMode = ADC_SCAN_DISABLE;
  hadc1.Init.EOCSelection = ADC_EOC_SINGLE_CONV;
  hadc1.Init.LowPowerAutoWait = DISABLE;
  hadc1.Init.ContinuousConvMode = DISABLE;
  hadc1.Init.NbrOfConversion = 1;
  hadc1.Init.DiscontinuousConvMode = DISABLE;
  hadc1.Init.ExternalTrigConv = ADC_SOFTWARE_START;
  hadc1.Init.ExternalTrigConvEdge = ADC_EXTERNALTRIGCONVEDGE_NONE;
  hadc1.Init.ConversionDataManagement = ADC_CONVERSIONDATA_DR;
  hadc1.Init.Overrun = ADC_OVR_DATA_PRESERVED;
  hadc1.Init.LeftBitShift = ADC_LEFTBITSHIFT_NONE;
  hadc1.Init.OversamplingMode = DISABLE;
  if (HAL_ADC_Init(&hadc1) != HAL_OK)
  {
    Error_Handler();
  }
  /** Configure the ADC multi-mode
  */
  multimode.Mode = ADC_MODE_INDEPENDENT;
  if (HAL_ADCEx_MultiModeConfigChannel(&hadc1, &multimode) != HAL_OK)
  {
    Error_Handler();
  }
  /** Configure Regular Channel
  */
  sConfig.Channel = ADC_CHANNEL_1;
  sConfig.Rank = ADC_REGULAR_RANK_1;
  sConfig.SamplingTime = ADC_SAMPLETIME_1CYCLE_5;
  sConfig.SingleDiff = ADC_DIFFERENTIAL_ENDED;
  sConfig.OffsetNumber = ADC_OFFSET_NONE;
  sConfig.Offset = 0;
  if (HAL_ADC_ConfigChannel(&hadc1, &sConfig) != HAL_OK)
  {
    Error_Handler();
  }

}

static void MX_DFSDM1_Init(void)
{

  hdfsdm1_channel1.Instance = DFSDM1_Channel1;
  hdfsdm1_channel1.Init.OutputClock.Activation = ENABLE;
  hdfsdm1_channel1.Init.OutputClock.Selection = DFSDM_CHANNEL_OUTPUT_CLOCK_SYSTEM;
  hdfsdm1_channel1.Init.OutputClock.Divider = 2;
  hdfsdm1_channel1.Init.Input.Multiplexer = DFSDM_CHANNEL_EXTERNAL_INPUTS;
  hdfsdm1_channel1.Init.Input.DataPacking = DFSDM_CHANNEL_STANDARD_MODE;
  hdfsdm1_channel1.Init.Input.Pins = DFSDM_CHANNEL_SAME_CHANNEL_PINS;
  hdfsdm1_channel1.Init.SerialInterface.Type = DFSDM_CHANNEL_SPI_RISING;
  hdfsdm1_channel1.Init.SerialInterface.SpiClock = DFSDM_CHANNEL_SPI_CLOCK_INTERNAL;
  hdfsdm1_channel1.Init.Awd.FilterOrder = DFSDM_CHANNEL_FASTSINC_ORDER;
  hdfsdm1_channel1.Init.Awd.Oversampling = 1;
  hdfsdm1_channel1.Init.Offset = 0;
  hdfsdm1_channel1.Init.RightBitShift = 0x00;
  if (HAL_DFSDM_ChannelInit(&hdfsdm1_channel1) != HAL_OK)
  {
    Error_Handler();
  }

}

static void MX_ETH_Init(void)
{

  heth.Instance = ETH;
  heth.Init.MACAddr[0] =   0x00;
  heth.Init.MACAddr[1] =   0x80;
  heth.Init.MACAddr[2] =   0xE1;
  heth.Init.MACAddr[3] =   0x00;
  heth.Init.MACAddr[4] =   0x00;
  heth.Init.MACAddr[5] =   0x00;
  heth.Init.MediaInterface = HAL_ETH_RMII_MODE;
  heth.Init.TxDesc = DMATxDscrTab;
  heth.Init.RxDesc = DMARxDscrTab;
  heth.Init.RxBuffLen = 1524;

  if (HAL_ETH_Init(&heth) != HAL_OK)
  {
    Error_Handler();
  }

  memset(&TxConfig, 0 , sizeof(ETH_TxPacketConfig));
  TxConfig.Attributes = ETH_TX_PACKETS_FEATURES_CSUM | ETH_TX_PACKETS_FEATURES_CRCPAD;
  TxConfig.ChecksumCtrl = ETH_CHECKSUM_IPHDR_PAYLOAD_INSERT_PHDR_CALC;
  TxConfig.CRCPadCtrl = ETH_CRC_PAD_INSERT;

}

static void MX_I2C1_Init(void)
{

  hi2c1.Instance = I2C1;
  hi2c1.Init.Timing = 0x10909CEC;
  hi2c1.Init.OwnAddress1 = 0;
  hi2c1.Init.AddressingMode = I2C_ADDRESSINGMODE_7BIT;
  hi2c1.Init.DualAddressMode = I2C_DUALADDRESS_DISABLE;
  hi2c1.Init.OwnAddress2 = 0;
  hi2c1.Init.OwnAddress2Masks = I2C_OA2_NOMASK;
  hi2c1.Init.GeneralCallMode = I2C_GENERALCALL_DISABLE;
  hi2c1.Init.NoStretchMode = I2C_NOSTRETCH_DISABLE;
  if (HAL_I2C_Init(&hi2c1) != HAL_OK)
  {
    Error_Handler();
  }
  /** Configure Analogue filter
  */
  if (HAL_I2CEx_ConfigAnalogFilter(&hi2c1, I2C_ANALOGFILTER_ENABLE) != HAL_OK)
  {
    Error_Handler();
  }
  /** Configure Digital filter
  */
  if (HAL_I2CEx_ConfigDigitalFilter(&hi2c1, 0) != HAL_OK)
  {
    Error_Handler();
  }

}

static void MX_LTDC_Init(void)
{

  LTDC_LayerCfgTypeDef pLayerCfg = {0};

  hltdc.Instance = LTDC;
  hltdc.Init.HSPolarity = LTDC_HSPOLARITY_AL;
  hltdc.Init.VSPolarity = LTDC_VSPOLARITY_AL;
  hltdc.Init.DEPolarity = LTDC_DEPOLARITY_AL;
  hltdc.Init.PCPolarity = LTDC_PCPOLARITY_IPC;
  hltdc.Init.HorizontalSync = 7;
  hltdc.Init.VerticalSync = 3;
  hltdc.Init.AccumulatedHBP = 14;
  hltdc.Init.AccumulatedVBP = 5;
  hltdc.Init.AccumulatedActiveW = 654;
  hltdc.Init.AccumulatedActiveH = 485;
  hltdc.Init.TotalWidth = 660;
  hltdc.Init.TotalHeigh = 487;
  hltdc.Init.Backcolor.Blue = 0;
  hltdc.Init.Backcolor.Green = 0;
  hltdc.Init.Backcolor.Red = 0;
  if (HAL_LTDC_Init(&hltdc) != HAL_OK)
  {
    Error_Handler();
  }
  pLayerCfg.WindowX0 = 0;
  pLayerCfg.WindowX1 = 640;
  pLayerCfg.WindowY0 = 0;
  pLayerCfg.WindowY1 = 480;
  pLayerCfg.PixelFormat = LTDC_PIXEL_FORMAT_ARGB8888;
  pLayerCfg.Alpha = 0;
  pLayerCfg.Alpha0 = 0;
  pLayerCfg.BlendingFactor1 = LTDC_BLENDING_FACTOR1_CA;
  pLayerCfg.BlendingFactor2 = LTDC_BLENDING_FACTOR2_CA;
  pLayerCfg.FBStartAdress = 0;
  pLayerCfg.ImageWidth = 0;
  pLayerCfg.ImageHeight = 0;
  pLayerCfg.Backcolor.Blue = 0;
  pLayerCfg.Backcolor.Green = 255;
  pLayerCfg.Backcolor.Red = 0;
  if (HAL_LTDC_ConfigLayer(&hltdc, &pLayerCfg, 0) != HAL_OK)
  {
    Error_Handler();
  }
  /* USER CODE BEGIN LTDC_Init 2 */

  //pLayerCfg.FBStartAdress = (uint32_t)&image_data_Image;
  //pLayerCfg.Alpha = 255; // Solid color
  if (HAL_LTDC_ConfigLayer(&hltdc, &pLayerCfg, 0) != HAL_OK)
  {
	  Error_Handler();
  }

  /* USER CODE END LTDC_Init 2 */

}

static void MX_QUADSPI_Init(void)
{

  /* QUADSPI parameter configuration*/
  hqspi.Instance = QUADSPI;
  hqspi.Init.ClockPrescaler = 255;
  hqspi.Init.FifoThreshold = 1;
  hqspi.Init.SampleShifting = QSPI_SAMPLE_SHIFTING_NONE;
  hqspi.Init.FlashSize = 1;
  hqspi.Init.ChipSelectHighTime = QSPI_CS_HIGH_TIME_1_CYCLE;
  hqspi.Init.ClockMode = QSPI_CLOCK_MODE_0;
  hqspi.Init.DualFlash = QSPI_DUALFLASH_ENABLE;
  if (HAL_QSPI_Init(&hqspi) != HAL_OK)
  {
    Error_Handler();
  }

}

static void MX_SAI1_Init(void)
{

  hsai_BlockA1.Instance = SAI1_Block_A;
  hsai_BlockA1.Init.Protocol = SAI_FREE_PROTOCOL;
  hsai_BlockA1.Init.AudioMode = SAI_MODEMASTER_TX;
  hsai_BlockA1.Init.DataSize = SAI_DATASIZE_8;
  hsai_BlockA1.Init.FirstBit = SAI_FIRSTBIT_MSB;
  hsai_BlockA1.Init.ClockStrobing = SAI_CLOCKSTROBING_FALLINGEDGE;
  hsai_BlockA1.Init.Synchro = SAI_ASYNCHRONOUS;
  hsai_BlockA1.Init.OutputDrive = SAI_OUTPUTDRIVE_DISABLE;
  hsai_BlockA1.Init.NoDivider = SAI_MASTERDIVIDER_ENABLE;
  hsai_BlockA1.Init.FIFOThreshold = SAI_FIFOTHRESHOLD_EMPTY;
  hsai_BlockA1.Init.AudioFrequency = SAI_AUDIO_FREQUENCY_192K;
  hsai_BlockA1.Init.SynchroExt = SAI_SYNCEXT_DISABLE;
  hsai_BlockA1.Init.MonoStereoMode = SAI_STEREOMODE;
  hsai_BlockA1.Init.CompandingMode = SAI_NOCOMPANDING;
  hsai_BlockA1.Init.TriState = SAI_OUTPUT_NOTRELEASED;
  hsai_BlockA1.Init.PdmInit.Activation = DISABLE;
  hsai_BlockA1.Init.PdmInit.MicPairsNbr = 1;
  hsai_BlockA1.Init.PdmInit.ClockEnable = SAI_PDM_CLOCK1_ENABLE;
  hsai_BlockA1.FrameInit.FrameLength = 8;
  hsai_BlockA1.FrameInit.ActiveFrameLength = 1;
  hsai_BlockA1.FrameInit.FSDefinition = SAI_FS_STARTFRAME;
  hsai_BlockA1.FrameInit.FSPolarity = SAI_FS_ACTIVE_LOW;
  hsai_BlockA1.FrameInit.FSOffset = SAI_FS_FIRSTBIT;
  hsai_BlockA1.SlotInit.FirstBitOffset = 0;
  hsai_BlockA1.SlotInit.SlotSize = SAI_SLOTSIZE_DATASIZE;
  hsai_BlockA1.SlotInit.SlotNumber = 1;
  hsai_BlockA1.SlotInit.SlotActive = 0x00000000;
  if (HAL_SAI_Init(&hsai_BlockA1) != HAL_OK)
  {
    Error_Handler();
  }
  hsai_BlockB1.Instance = SAI1_Block_B;
  hsai_BlockB1.Init.Protocol = SAI_FREE_PROTOCOL;
  hsai_BlockB1.Init.AudioMode = SAI_MODESLAVE_RX;
  hsai_BlockB1.Init.DataSize = SAI_DATASIZE_8;
  hsai_BlockB1.Init.FirstBit = SAI_FIRSTBIT_MSB;
  hsai_BlockB1.Init.ClockStrobing = SAI_CLOCKSTROBING_FALLINGEDGE;
  hsai_BlockB1.Init.Synchro = SAI_SYNCHRONOUS;
  hsai_BlockB1.Init.OutputDrive = SAI_OUTPUTDRIVE_DISABLE;
  hsai_BlockB1.Init.FIFOThreshold = SAI_FIFOTHRESHOLD_EMPTY;
  hsai_BlockB1.Init.SynchroExt = SAI_SYNCEXT_DISABLE;
  hsai_BlockB1.Init.MonoStereoMode = SAI_STEREOMODE;
  hsai_BlockB1.Init.CompandingMode = SAI_NOCOMPANDING;
  hsai_BlockB1.Init.TriState = SAI_OUTPUT_NOTRELEASED;
  hsai_BlockB1.Init.PdmInit.Activation = DISABLE;
  hsai_BlockB1.Init.PdmInit.MicPairsNbr = 1;
  hsai_BlockB1.Init.PdmInit.ClockEnable = SAI_PDM_CLOCK1_ENABLE;
  hsai_BlockB1.FrameInit.FrameLength = 8;
  hsai_BlockB1.FrameInit.ActiveFrameLength = 1;
  hsai_BlockB1.FrameInit.FSDefinition = SAI_FS_STARTFRAME;
  hsai_BlockB1.FrameInit.FSPolarity = SAI_FS_ACTIVE_LOW;
  hsai_BlockB1.FrameInit.FSOffset = SAI_FS_FIRSTBIT;
  hsai_BlockB1.SlotInit.FirstBitOffset = 0;
  hsai_BlockB1.SlotInit.SlotSize = SAI_SLOTSIZE_DATASIZE;
  hsai_BlockB1.SlotInit.SlotNumber = 1;
  hsai_BlockB1.SlotInit.SlotActive = 0x00000000;
  if (HAL_SAI_Init(&hsai_BlockB1) != HAL_OK)
  {
    Error_Handler();
  }

}

static void MX_SDMMC1_SD_Init(void)
{

  hsd1.Instance = SDMMC1;
  hsd1.Init.ClockEdge = SDMMC_CLOCK_EDGE_RISING;
  hsd1.Init.ClockPowerSave = SDMMC_CLOCK_POWER_SAVE_DISABLE;
  hsd1.Init.BusWide = SDMMC_BUS_WIDE_4B;
  hsd1.Init.HardwareFlowControl = SDMMC_HARDWARE_FLOW_CONTROL_DISABLE;
  hsd1.Init.ClockDiv = 0;
  if (HAL_SD_Init(&hsd1) != HAL_OK)
  {
    Error_Handler();
  }

}

static void MX_USART1_UART_Init(void)
{

  huart1.Instance = USART1;
  huart1.Init.BaudRate = 115200;
  huart1.Init.WordLength = UART_WORDLENGTH_8B;
  huart1.Init.StopBits = UART_STOPBITS_1;
  huart1.Init.Parity = UART_PARITY_NONE;
  huart1.Init.Mode = UART_MODE_TX_RX;
  huart1.Init.HwFlowCtl = UART_HWCONTROL_NONE;
  huart1.Init.OverSampling = UART_OVERSAMPLING_16;
  huart1.Init.OneBitSampling = UART_ONE_BIT_SAMPLE_DISABLE;
  huart1.Init.ClockPrescaler = UART_PRESCALER_DIV1;
  huart1.AdvancedInit.AdvFeatureInit = UART_ADVFEATURE_NO_INIT;
  if (HAL_UART_Init(&huart1) != HAL_OK)
  {
    Error_Handler();
  }
  if (HAL_UARTEx_SetTxFifoThreshold(&huart1, UART_TXFIFO_THRESHOLD_1_8) != HAL_OK)
  {
    Error_Handler();
  }
  if (HAL_UARTEx_SetRxFifoThreshold(&huart1, UART_RXFIFO_THRESHOLD_1_8) != HAL_OK)
  {
    Error_Handler();
  }
  if (HAL_UARTEx_DisableFifoMode(&huart1) != HAL_OK)
  {
    Error_Handler();
  }

}

static void MX_USB_OTG_FS_PCD_Init(void)
{

  hpcd_USB_OTG_FS.Instance = USB_OTG_FS;
  hpcd_USB_OTG_FS.Init.dev_endpoints = 9;
  hpcd_USB_OTG_FS.Init.speed = PCD_SPEED_FULL;
  hpcd_USB_OTG_FS.Init.dma_enable = DISABLE;
  hpcd_USB_OTG_FS.Init.phy_itface = PCD_PHY_EMBEDDED;
  hpcd_USB_OTG_FS.Init.Sof_enable = DISABLE;
  hpcd_USB_OTG_FS.Init.low_power_enable = DISABLE;
  hpcd_USB_OTG_FS.Init.lpm_enable = DISABLE;
  hpcd_USB_OTG_FS.Init.battery_charging_enable = DISABLE;
  hpcd_USB_OTG_FS.Init.vbus_sensing_enable = DISABLE;
  hpcd_USB_OTG_FS.Init.use_dedicated_ep1 = DISABLE;
  if (HAL_PCD_Init(&hpcd_USB_OTG_FS) != HAL_OK)
  {
    Error_Handler();
  }

}

static void MX_USB_OTG_HS_PCD_Init(void)
{

  hpcd_USB_OTG_HS.Instance = USB_OTG_HS;
  hpcd_USB_OTG_HS.Init.dev_endpoints = 9;
  hpcd_USB_OTG_HS.Init.speed = PCD_SPEED_HIGH;
  hpcd_USB_OTG_HS.Init.dma_enable = DISABLE;
  hpcd_USB_OTG_HS.Init.phy_itface = USB_OTG_ULPI_PHY;
  hpcd_USB_OTG_HS.Init.Sof_enable = DISABLE;
  hpcd_USB_OTG_HS.Init.low_power_enable = DISABLE;
  hpcd_USB_OTG_HS.Init.lpm_enable = DISABLE;
  hpcd_USB_OTG_HS.Init.vbus_sensing_enable = DISABLE;
  hpcd_USB_OTG_HS.Init.use_dedicated_ep1 = DISABLE;
  hpcd_USB_OTG_HS.Init.use_external_vbus = DISABLE;
  if (HAL_PCD_Init(&hpcd_USB_OTG_HS) != HAL_OK)
  {
    Error_Handler();
  }

}

/* FMC initialization function */
static void MX_FMC_Init(void)
{

  FMC_NORSRAM_TimingTypeDef Timing = {0};
  FMC_SDRAM_TimingTypeDef SdramTiming = {0};

  /** Perform the NOR1 memory initialization sequence
  */
  hnor1.Instance = FMC_NORSRAM_DEVICE;
  hnor1.Extended = FMC_NORSRAM_EXTENDED_DEVICE;
  /* hnor1.Init */
  hnor1.Init.NSBank = FMC_NORSRAM_BANK1;
  hnor1.Init.DataAddressMux = FMC_DATA_ADDRESS_MUX_DISABLE;
  hnor1.Init.MemoryType = FMC_MEMORY_TYPE_NOR;
  hnor1.Init.MemoryDataWidth = FMC_NORSRAM_MEM_BUS_WIDTH_16;
  hnor1.Init.BurstAccessMode = FMC_BURST_ACCESS_MODE_DISABLE;
  hnor1.Init.WaitSignalPolarity = FMC_WAIT_SIGNAL_POLARITY_LOW;
  hnor1.Init.WaitSignalActive = FMC_WAIT_TIMING_BEFORE_WS;
  hnor1.Init.WriteOperation = FMC_WRITE_OPERATION_DISABLE;
  hnor1.Init.WaitSignal = FMC_WAIT_SIGNAL_DISABLE;
  hnor1.Init.ExtendedMode = FMC_EXTENDED_MODE_DISABLE;
  hnor1.Init.AsynchronousWait = FMC_ASYNCHRONOUS_WAIT_ENABLE;
  hnor1.Init.WriteBurst = FMC_WRITE_BURST_DISABLE;
  hnor1.Init.ContinuousClock = FMC_CONTINUOUS_CLOCK_SYNC_ONLY;
  hnor1.Init.WriteFifo = FMC_WRITE_FIFO_ENABLE;
  hnor1.Init.PageSize = FMC_PAGE_SIZE_NONE;
  /* Timing */
  Timing.AddressSetupTime = 15;
  Timing.AddressHoldTime = 15;
  Timing.DataSetupTime = 255;
  Timing.BusTurnAroundDuration = 15;
  Timing.CLKDivision = 16;
  Timing.DataLatency = 17;
  Timing.AccessMode = FMC_ACCESS_MODE_A;
  /* ExtTiming */

  if (HAL_NOR_Init(&hnor1, &Timing, NULL) != HAL_OK)
  {
    Error_Handler( );
  }

  /** Perform the SRAM2 memory initialization sequence
  */
  hsram2.Instance = FMC_NORSRAM_DEVICE;
  hsram2.Extended = FMC_NORSRAM_EXTENDED_DEVICE;
  /* hsram2.Init */
  hsram2.Init.NSBank = FMC_NORSRAM_BANK3;
  hsram2.Init.DataAddressMux = FMC_DATA_ADDRESS_MUX_DISABLE;
  hsram2.Init.MemoryType = FMC_MEMORY_TYPE_SRAM;
  hsram2.Init.MemoryDataWidth = FMC_NORSRAM_MEM_BUS_WIDTH_16;
  hsram2.Init.BurstAccessMode = FMC_BURST_ACCESS_MODE_DISABLE;
  hsram2.Init.WaitSignalPolarity = FMC_WAIT_SIGNAL_POLARITY_LOW;
  hsram2.Init.WaitSignalActive = FMC_WAIT_TIMING_BEFORE_WS;
  hsram2.Init.WriteOperation = FMC_WRITE_OPERATION_DISABLE;
  hsram2.Init.WaitSignal = FMC_WAIT_SIGNAL_DISABLE;
  hsram2.Init.ExtendedMode = FMC_EXTENDED_MODE_DISABLE;
  hsram2.Init.AsynchronousWait = FMC_ASYNCHRONOUS_WAIT_ENABLE;
  hsram2.Init.WriteBurst = FMC_WRITE_BURST_DISABLE;
  hsram2.Init.ContinuousClock = FMC_CONTINUOUS_CLOCK_SYNC_ONLY;
  hsram2.Init.WriteFifo = FMC_WRITE_FIFO_ENABLE;
  hsram2.Init.PageSize = FMC_PAGE_SIZE_NONE;
  /* Timing */
  Timing.AddressSetupTime = 15;
  Timing.AddressHoldTime = 15;
  Timing.DataSetupTime = 255;
  Timing.BusTurnAroundDuration = 15;
  Timing.CLKDivision = 16;
  Timing.DataLatency = 17;
  Timing.AccessMode = FMC_ACCESS_MODE_A;
  /* ExtTiming */

  if (HAL_SRAM_Init(&hsram2, &Timing, NULL) != HAL_OK)
  {
    Error_Handler( );
  }

  /** Perform the SDRAM1 memory initialization sequence
  */
  hsdram1.Instance = FMC_SDRAM_DEVICE;
  /* hsdram1.Init */
  hsdram1.Init.SDBank = FMC_SDRAM_BANK2;
  hsdram1.Init.ColumnBitsNumber = FMC_SDRAM_COLUMN_BITS_NUM_8;
  hsdram1.Init.RowBitsNumber = FMC_SDRAM_ROW_BITS_NUM_11;
  hsdram1.Init.MemoryDataWidth = FMC_SDRAM_MEM_BUS_WIDTH_32;
  hsdram1.Init.InternalBankNumber = FMC_SDRAM_INTERN_BANKS_NUM_4;
  hsdram1.Init.CASLatency = FMC_SDRAM_CAS_LATENCY_1;
  hsdram1.Init.WriteProtection = FMC_SDRAM_WRITE_PROTECTION_DISABLE;
  hsdram1.Init.SDClockPeriod = FMC_SDRAM_CLOCK_DISABLE;
  hsdram1.Init.ReadBurst = FMC_SDRAM_RBURST_DISABLE;
  hsdram1.Init.ReadPipeDelay = FMC_SDRAM_RPIPE_DELAY_0;
  /* SdramTiming */
  SdramTiming.LoadToActiveDelay = 16;
  SdramTiming.ExitSelfRefreshDelay = 16;
  SdramTiming.SelfRefreshTime = 16;
  SdramTiming.RowCycleDelay = 16;
  SdramTiming.WriteRecoveryTime = 16;
  SdramTiming.RPDelay = 16;
  SdramTiming.RCDDelay = 16;

  if (HAL_SDRAM_Init(&hsdram1, &SdramTiming) != HAL_OK)
  {
    Error_Handler( );
  }

}

static void MX_GPIO_Init(void)
{
  GPIO_InitTypeDef GPIO_InitStruct = {0};

  /* GPIO Ports Clock Enable */
  __HAL_RCC_GPIOI_CLK_ENABLE();
  __HAL_RCC_GPIOB_CLK_ENABLE();
  __HAL_RCC_GPIOK_CLK_ENABLE();
  __HAL_RCC_GPIOG_CLK_ENABLE();
  __HAL_RCC_GPIOD_CLK_ENABLE();
  __HAL_RCC_GPIOC_CLK_ENABLE();
  __HAL_RCC_GPIOE_CLK_ENABLE();
  __HAL_RCC_GPIOJ_CLK_ENABLE();
  __HAL_RCC_GPIOH_CLK_ENABLE();
  __HAL_RCC_GPIOA_CLK_ENABLE();
  __HAL_RCC_GPIOF_CLK_ENABLE();

  /*Configure GPIO pin Output Level */
  HAL_GPIO_WritePin(FDCAN1_STBY_GPIO_Port, FDCAN1_STBY_Pin, GPIO_PIN_RESET);

  /*Configure GPIO pin Output Level */
  HAL_GPIO_WritePin(LED1_RGB_GPIO_Port, LED1_RGB_Pin, GPIO_PIN_RESET);

  /*Configure GPIO pin Output Level */
  HAL_GPIO_WritePin(GPIOA, LCD_BL_CTRL_Pin|LED3_RGB_Pin, GPIO_PIN_RESET);

  /*Configure GPIO pin : FDCAN1_STBY_Pin */
  GPIO_InitStruct.Pin = FDCAN1_STBY_Pin;
  GPIO_InitStruct.Mode = GPIO_MODE_OUTPUT_PP;
  GPIO_InitStruct.Pull = GPIO_NOPULL;
  GPIO_InitStruct.Speed = GPIO_SPEED_FREQ_LOW;
  HAL_GPIO_Init(FDCAN1_STBY_GPIO_Port, &GPIO_InitStruct);

  /*Configure GPIO pin : PDM1_CLK_Pin */
  GPIO_InitStruct.Pin = PDM1_CLK_Pin;
  GPIO_InitStruct.Mode = GPIO_MODE_AF_PP;
  GPIO_InitStruct.Pull = GPIO_NOPULL;
  GPIO_InitStruct.Speed = GPIO_SPEED_FREQ_LOW;
  GPIO_InitStruct.Alternate = GPIO_AF10_SAI4;
  HAL_GPIO_Init(PDM1_CLK_GPIO_Port, &GPIO_InitStruct);

  /*Configure GPIO pin : MFX_IRQOUT_Pin */
  GPIO_InitStruct.Pin = MFX_IRQOUT_Pin;
  GPIO_InitStruct.Mode = GPIO_MODE_IT_RISING;
  GPIO_InitStruct.Pull = GPIO_NOPULL;
  HAL_GPIO_Init(MFX_IRQOUT_GPIO_Port, &GPIO_InitStruct);

  /*Configure GPIO pin : MCO_Pin */
  GPIO_InitStruct.Pin = MCO_Pin;
  GPIO_InitStruct.Mode = GPIO_MODE_AF_PP;
  GPIO_InitStruct.Pull = GPIO_NOPULL;
  GPIO_InitStruct.Speed = GPIO_SPEED_FREQ_LOW;
  GPIO_InitStruct.Alternate = GPIO_AF0_MCO;
  HAL_GPIO_Init(MCO_GPIO_Port, &GPIO_InitStruct);

  /*Configure GPIO pin : LED1_RGB_Pin */
  GPIO_InitStruct.Pin = LED1_RGB_Pin;
  GPIO_InitStruct.Mode = GPIO_MODE_OUTPUT_PP;
  GPIO_InitStruct.Pull = GPIO_NOPULL;
  GPIO_InitStruct.Speed = GPIO_SPEED_FREQ_LOW;
  HAL_GPIO_Init(LED1_RGB_GPIO_Port, &GPIO_InitStruct);

  /*Configure GPIO pins : LCD_BL_CTRL_Pin LED3_RGB_Pin */
  GPIO_InitStruct.Pin = LCD_BL_CTRL_Pin|LED3_RGB_Pin;
  GPIO_InitStruct.Mode = GPIO_MODE_OUTPUT_PP;
  GPIO_InitStruct.Pull = GPIO_NOPULL;
  GPIO_InitStruct.Speed = GPIO_SPEED_FREQ_LOW;
  HAL_GPIO_Init(GPIOA, &GPIO_InitStruct);

}

void Error_Handler(void)
{
}

/************************ (C) COPYRIGHT STMicroelectronics *****END OF FILE****/
